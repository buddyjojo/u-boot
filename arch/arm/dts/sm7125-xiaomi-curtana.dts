// SPDX-License-Identifier: GPL-2.0
/*
 * Copyright (c) 2023, Joe Mason <buddyjojo06@outlook.com>
 */

/dts-v1/;

#include "sm7125-xiaomi-miatoll.dtsi"

/ {
	model = "Xiaomi Redmi Note 9s";
	compatible = "xiaomi,curtana", "qcom,sm7125";

	/* required for bootloader to select correct board */
	qcom,board-id = <0x20022 1>;
};
